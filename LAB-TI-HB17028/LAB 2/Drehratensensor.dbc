VERSION ""

NS_ :

BS_:

BU_: Drehratensensor

BO_ 512 Drehbeschleunigung2: 8 Drehratensensor
 SG_ QuerbeschleunigungY : 16|32@1+ (0.000127465,-4.1768) [-4.1768|547453.829457175] "g" Vector__XXX
 SG_ Drehbeschleunigung : 0|16@1+ (0.125,-4.096) [-4.096|8187.779] "*/s^2" Vector__XXX

BO_ 256 Drehgeschwindigkeit1: 4 Drehratensensor
 SG_ QuerbeschleunigungX : 32|32@1+ (0.000127465,-4.1768) [-4.1768|547453.829457175] "g" Vector__XXX
 SG_ Drehgeschwindigkeit : 0|16@1+ (0.005,-163.84) [-163.84|163.835] "*/s" Vector__XXX
